# MCF5441x register map
Vendor: NXP; File version: 1.0
Registers are 32-bit, read-write, reset 0x0 unless marked. A register's access mark holds for its fields unless they carry their own. Offsets are from the block's base; lines under a group give offsets from that group; [hi:lo] are bit positions; {n}, {i} and the like mark numbered series; 'fields as' and 'values as' point back to an identical list; <NAME> marks a mode.

## Memory map
0x8C000000 RGPIO size 0x10
0xEC008000 OW size 0x19
0xEC010000 I2C2 size 0x11
0xEC014000 I2C3 size 0x11
0xEC018000 I2C4 size 0x11
0xEC01C000 I2C5 size 0x11
0xEC038000 DSPI2 size 0xBC
0xEC03C000 DSPI3 size 0xBC
0xEC060000 UART4 size 0x3D
0xEC064000 UART5 size 0x3D
0xEC068000 UART6 size 0x3D
0xEC06C000 UART7 size 0x3D
0xEC070000 UART8 size 0x3D
0xEC074000 UART9 size 0x3D
0xEC088000 MCPWM size 0x152
0xEC090000 CCM size 0x28
0xEC094000 GPIO size 0x88
0xFC004000 XBS size 0x714
0xFC008000 FLEXBUS size 0x48
0xFC020000 FLEXCAN0 size 0x8C0
0xFC024000 FLEXCAN1 size 0x8C0
0xFC038000 I2C1 size 0x11
0xFC03C000 DSPI1 size 0xBC
0xFC040000 SCM size 0x80
0xFC044000 EDMA size 0x1800
0xFC048000 INTC0 size 0xFD
0xFC04C000 INTC1 size 0xFD
0xFC050000 INTC2 size 0xFD
0xFC054000 IACK size 0xFD
0xFC058000 I2C0 size 0x11
0xFC05C000 DSPI0 size 0xBC
0xFC060000 UART0 size 0x3D
0xFC064000 UART1 size 0x3D
0xFC068000 UART2 size 0x3D
0xFC06C000 UART3 size 0x3D
0xFC070000 DTIM0 size 0x10
0xFC074000 DTIM1 size 0x10
0xFC078000 DTIM2 size 0x10
0xFC07C000 DTIM3 size 0x10
0xFC080000 PIT0 size 0x6
0xFC084000 PIT1 size 0x6
0xFC088000 PIT2 size 0x6
0xFC08C000 PIT3 size 0x6
0xFC090000 EPORT size 0x7
0xFC094000 ADC size 0x5C
0xFC098000 DAC0 size 0xE
0xFC09C000 DAC1 size 0xE
0xFC0A8000 RTC size 0x36
0xFC0AC000 SIM size 0x7C
0xFC0B0000 USBOTG size 0x1D0
0xFC0B4000 USBHOST size 0x1AC
0xFC0B8000 DDRMC size 0x1B0
0xFC0BC000 SSI0 size 0x5C
0xFC0C0000 PLL size 0xC
0xFC0C4000 RNG size 0x1C
0xFC0C8000 SSI1 size 0x5C
0xFC0CC000 ESDHC size 0x100
0xFC0D4000 MACNET0 size 0x520
0xFC0D8000 MACNET1 size 0x520
0xFC0DC000 ESW size 0x8000
0xFC0FC000 NFC size 0x3F3C

## Interrupts
65 EPORT_EPF1 (EPORT)
66 EPORT_EPF2 (EPORT)
67 EPORT_EPF3 (EPORT)
68 EPORT_EPF4 (EPORT)
69 EPORT_EPF5 (EPORT)
70 EPORT_EPF6 (EPORT)
71 EPORT_EPF7 (EPORT)
{n+72} EDMA_INTR_INT{n:02} (EDMA) (n=0..15)
88 EDMA_ERR_ERR_N (EDMA)
89 SCMIR_CWIC (SCM)
90 UART0
91 UART1
92 UART2
93 UART3
94 I2C0
95 DSPI0_SR (DSPI0)
96 DTIM0
97 DTIM1
98 DTIM2
99 DTIM3
100 ENET0_EIR_TXF (MACNET0)
101 ENET0_EIR_TXB (MACNET0)
102 ENET0_EIR_UN (MACNET0)
103 ENET0_EIR_RL (MACNET0)
104 ENET0_EIR_RXF (MACNET0)
105 ENET0_EIR_RXB (MACNET0)
106 ENET0_EIR_MII (MACNET0)
107 ENET0_EIR_LC (MACNET0)
109 ENET0_EIR_GRA (MACNET0)
110 ENET0_EIR_EBERR (MACNET0)
111 ENET0_EIR_BABT (MACNET0)
112 ENET0_EIR_BABR (MACNET0)
113 ENET1_EIR_TXF (MACNET1)
114 ENET1_EIR_TXB (MACNET1)
115 ENET1_EIR_UN (MACNET1)
116 ENET1_EIR_RL (MACNET1)
117 ENET1_EIR_RXF (MACNET1)
118 ENET1_EIR_RXB (MACNET1)
119 ENET1_EIR_MII (MACNET1)
120 ENET1_EIR_LC (MACNET1)
122 ENET1_EIR_GRA (MACNET1)
123 ENET1_EIR_EBERR (MACNET1)
124 ENET1_EIR_BABT (MACNET1)
125 ENET1_EIR_BABR (MACNET1)
126 SCMIR_CFEI (SCM)
127 OW_ISR (OW)
128 FLEXCAN0_BUF (FLEXCAN0)
129 FLEXCAN0_BOFF (FLEXCAN0)
131 FLEXCAN0_TXWRN (FLEXCAN0)
132 FLEXCAN1_BUF (FLEXCAN1)
133 FLEXCAN1_BOFF (FLEXCAN1)
135 FLEXCAN1_TXWRN (FLEXCAN1)
{n+120} EDMA_INTR_INT{n} (EDMA) (n=16..55)
176 UART4
177 UART5
178 UART6
179 UART7
180 UART8
181 UART9
182 DSPI1_SR (DSPI1)
183 DSPI2_SR (DSPI2)
184 DSPI3_SR (DSPI3)
185 I2C1
186 I2C2
187 I2C3
188 I2C4
189 I2C5
192 EDMA_INTR_INT56_63 (EDMA)
193 PWM_SM0SR_CF_XN (MCPWM)
194 PWM_SM1SR_CF_XN (MCPWM)
195 PWM_SM2SR_CF_XN (MCPWM)
196 PWM_SM3SR_CF_XN (MCPWM)
197 PWM_SM0SR_RF (MCPWM)
198 PWM_SM1SR_RF (MCPWM)
199 PWM_SM2SR_RF (MCPWM)
200 PWM_SM3SR_RF (MCPWM)
201 PWM_FSR_FFLAG (MCPWM)
202 PWM_REF (MCPWM)
203 PLL_SR_LOCF (PLL)
204 PLL_SR_LOLF (PLL)
205 PIT0
206 PIT1
207 PIT2
208 PIT3
209 USBOTG
210 USBHOST
211 PWM_SM0SR_CMPF (MCPWM)
212 PWM_SM1SR_CMPF (MCPWM)
213 PWM_SM2SR_CMPF (MCPWM)
214 PWM_SM3SR_CMPF (MCPWM)
215 SSI0_ISR (SSI0)
216 SSI1_ISR (SSI1)
217 NFC_ISR (NFC)
218 RTC_ISR (RTC)
219 CCM_UOCSR (CCM)
220 RNG
221 SIM_TSR (SIM)
222 SIM_RSR (SIM)
223 ESDHC
224 ADC_SR_EOSI0 (ADC)
225 ADC_SR_EOSI1 (ADC)
226 ADC_LSR_ZCSR (ADC)
228 DDR_CR27 (DDRMC)
230 ESW_ISR_EBERR (ESW)
231 ESW_ISR_RXB (ESW)
232 ESW_ISR_RXF (ESW)
233 ESW_ISR_TXB (ESW)
234 ESW_ISR_TXF (ESW)
235 ESW_ISR_QM (ESW)
236 ESW_ISR_OD0 (ESW)
237 ESW_ISR_OD1 (ESW)
238 ESW_ISR_OD2 (ESW)
239 ESW_ISR_LRN (ESW)
240 ENET0_EIR_TS_AVAIL (MACNET0)
241 ENET0_EIR_WAKEUP (MACNET0)
242 ENET0_EIR_PLR (MACNET0)
247 ENET1_EIR_TS_AVAIL (MACNET1)
248 ENET1_EIR_WAKEUP (MACNET1)
249 ENET1_EIR_PLR (MACNET1)
